## drivers/platform/xiaomi/Kconfig
```kconfig
# Xiaomi configuration options

config MACH_XIAOMI
	bool "Xiaomi device"
	depends on ARCH_QCOM
	help
	  Support for Xiaomi products

config MACH_XIAOMI_SDM660
	bool "Xiaomi SDM660"
	depends on ARCH_QCOM
	select MACH_XIAOMI
	help
	  Support for Xiaomi SDM660 devices

menu "Xiaomi board selection"

	config MACH_XIAOMI_TULIP
		bool "Xiaomi tulip board"
		select MACH_XIAOMI_SDM660
		help
		  Support for Xiaomi Redmi Note 6 Pro

endmenu
```

## fs/incfs/Kconfig
```kconfig
config INCREMENTAL_FS
	tristate "Incremental file system support"
	depends on BLOCK && CRC32
	help
	  Incremental FS is a read-only virtual file system that facilitates execution
	  of programs while their binaries are still being lazily downloaded over the
	  network, USB or pigeon post.

	  To compile this file system support as a module, choose M here: the
	  module will be called incrementalfs.
```
